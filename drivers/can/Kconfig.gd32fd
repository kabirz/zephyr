## drivers/can/Kconfig.gd32fd
```kconfig
# Copyright (c) 2026 GD32H7xx Zephyr bring-up
# SPDX-License-Identifier: Apache-2.0

config CAN_GD32FD
	bool "GigaDevice GD32H7xx CAN-FD driver"
	default y
	depends on DT_HAS_GD_GD32_CAN_ENABLED
	select PINCTRL
	select USE_GD32_CAN
	select CAN_FD_MODE
	help
	  Enable the GigaDevice GD32H7xx CAN-FD controller driver. Supports
	  classic CAN and CAN-FD frames (up to 64 data bytes with bit rate
	  switching).

config CAN_GD32FD_MAX_FILTER
	int "Maximum number of concurrent CAN RX software filters"
	default 8
	range 1 1024
	depends on CAN_GD32FD
	help
	  Defines the size of the array of software RX filters.
```

## drivers/entropy/Kconfig.gd32
```kconfig
# GD32 TRNG configuration

# Copyright (c) 2025 Aleksandr Senin <al@meshium.net>
# SPDX-License-Identifier: Apache-2.0

config ENTROPY_GD32_TRNG
	bool "GigaDevice GD32F4xx TRNG driver"
	default y
	depends on DT_HAS_GD_GD32_TRNG_ENABLED
	depends on !SOC_SERIES_GD32H7XX
	select ENTROPY_HAS_DRIVER
	select USE_GD32_TRNG
	help
	  Enable True Random Number Generator (TRNG) driver for GigaDevice
	  GD32F4xx series. This driver uses the GD32 HAL and operates in
	  polling mode.

config ENTROPY_GD32_H7_TRNG
	bool "GigaDevice GD32H7xx TRNG driver"
	default y
	depends on DT_HAS_GD_GD32_TRNG_ENABLED
	depends on SOC_SERIES_GD32H7XX
	select ENTROPY_HAS_DRIVER
	select USE_GD32_TRNG
	help
	  Enable True Random Number Generator (TRNG) driver for GigaDevice
	  GD32H7xx series. This driver uses the GD32 HAL and operates in
	  polling mode.  The H7 TRNG sits on AHB2 and needs no 48MHz
	  auxiliary clock.
```

## drivers/ethernet/Kconfig.gd32
```kconfig
# Copyright (c) 2026 GD32H7xx Zephyr bring-up
# SPDX-License-Identifier: Apache-2.0

config ETH_GD32
	bool "GigaDevice GD32H7xx Ethernet driver"
	default y
	depends on DT_HAS_GD_GD32_ETH_ENABLED
	depends on NET_L2_ETHERNET
	select PINCTRL
	help
	  Enable the GigaDevice GD32H7xx Ethernet MAC driver (ENET0/ENET1).
	  Supports MII and RMII PHY interfaces (selected in SYSCFG) with the
	  PHY driven over MDIO; the PHY address is auto-detected unless the
	  `phy-address` property is set in devicetree.

config ETH_GD32_RX_THREAD_STACK_SIZE
	int "RX thread stack size"
	default 2048
	depends on ETH_GD32
	help
	  Stack size of the RX processing thread.

config ETH_GD32_RX_THREAD_PRIO
	int "RX thread priority"
	default 2
	depends on ETH_GD32
	help
	  Priority of the RX processing thread.

config ETH_GD32_RX_DESC_NUM
	int "Number of RX DMA descriptors"
	default 8
	range 2 32
	depends on ETH_GD32
	help
	  Size of the RX descriptor ring.  Each descriptor owns a dedicated
	  1536-byte buffer.  The descriptors live in the peripheral SRAM0
	  region, which the ENET DMA requires; with cache management enabled
	  the frame buffers can live in the default SRAM, allowing rings
	  larger than the 16 KB SRAM0 could hold.

config ETH_GD32_SRAM0_BUDGET
	int "SRAM0 budget for ENET descriptors and buffers (bytes)"
	default 16384
	depends on ETH_GD32
	help
	  Size of the peripheral SRAM0 region reserved for the ENET DMA
	  descriptor ring and frame buffers.  The build fails if the
	  configured ring does not fit.

config ETH_GD32_IRQ_TEST
	bool "GD32 ENET interrupt diagnosis hooks (bring-up only)"
	default n
	depends on ETH_GD32
	select SHELL
	help
	  Adds a `gdeth` shell command group that controls the DMA interrupt
	  enable register at runtime and counts the interrupt sources seen by
	  the ISR.  For bring-up debugging only; leave off in production.

config ETH_GD32_RX_BATCH
	int "RX frames processed per wakeup"
	default 8
	range 1 64
	depends on ETH_GD32
	help
	  Upper bound on frames the RX thread drains per wakeup before it
	  yields to lower-priority threads (the IP stack must run to keep
	  the TCP ACK path alive during receive bursts).
```

## drivers/flash/Kconfig.gd32
```kconfig
# Copyright (c) 2022 BrainCo Inc.
# SPDX-License-Identifier: Apache-2.0

config SOC_FLASH_GD32
	bool "GigaDevice GD32 flash driver"
	default y
	depends on (GD32_NV_FLASH_V1 || GD32_NV_FLASH_V2 || GD32_NV_FLASH_V3 || GD32_NV_FLASH_V4)
	select FLASH_HAS_DRIVER_ENABLED
	select FLASH_HAS_PAGE_LAYOUT
	select FLASH_HAS_EXPLICIT_ERASE
	select MPU_ALLOW_FLASH_WRITE if ARM_MPU
	help
	  Enable the GigaDevice GD32 flash driver.

config GD32_NV_FLASH_V1
	bool
	default y
	depends on DT_HAS_GD_GD32_NV_FLASH_V1_ENABLED
	help
	  Enable the generic backend for GD32 FMC v1 flash driver.

config GD32_NV_FLASH_V2
	bool
	default y
	depends on DT_HAS_GD_GD32_NV_FLASH_V2_ENABLED
	help
	  Enable the generic backend for GD32 FMC v2 flash driver.

config GD32_NV_FLASH_V3
	bool
	default y
	depends on DT_HAS_GD_GD32_NV_FLASH_V3_ENABLED
	help
	  Enable the generic backend for GD32 FMC v3 flash driver.

config GD32_NV_FLASH_V4
	bool
	default y
	depends on DT_HAS_GD_GD32_NV_FLASH_V4_ENABLED
	help
	  Enable the generic backend for GD32 FMC v4 flash driver.

config FLASH_GD32_OSPI
	bool "GigaDevice GD32H7xx OSPI NOR flash driver"
	default y
	depends on DT_HAS_GD_GD32_OSPI_ENABLED
	select FLASH_HAS_DRIVER_ENABLED
	select FLASH_HAS_PAGE_LAYOUT
	select FLASH_HAS_EXPLICIT_ERASE
	select PINCTRL
	select USE_GD32_OSPI
	help
	  Enable the GD32H7xx OSPI (OCTOSPI-style) controller driver for an
	  attached NOR flash, indirect mode with standard SPI (1-1-1)
	  commands.
```

## dts/bindings/can/gd,gd32-can.yaml
```yaml
# Copyright (c) 2026 GD32H7xx Zephyr bring-up
# SPDX-License-Identifier: Apache-2.0

description: |
  GigaDevice GD32H7xx CAN-FD controller (mailbox / message RAM based).
  Interrupt names: wkup, message, busoff, error, fasterror, tec, rec.

compatible: "gd,gd32-can"

include: [can-fd-controller.yaml, reset-device.yaml, pinctrl-device.yaml]

properties:
  reg:
    required: true

  interrupts:
    required: true

  interrupt-names:
    required: true

  resets:
    required: true

  clocks:
    required: true

  pinctrl-0:
    required: true

  pinctrl-names:
    required: true
```

## dts/bindings/ethernet/gd,gd32-eth.yaml
```yaml
# Copyright (c) 2026 GD32H7xx Zephyr bring-up
# SPDX-License-Identifier: Apache-2.0

description: |
  GigaDevice GD32 series Ethernet MAC (DesignWare-style MAC + DMA).

  The MII/RMII PHY interface is selected through SYSCFG; the driver enables
  RMII when an `rmii` property is present.  The driver manages the DMA
  descriptor rings itself and drives the PHY over MDIO (PHY address
  auto-detected at init unless the optional `phy-address` property is given).

compatible: "gd,gd32-eth"

include: [ethernet-controller.yaml, pinctrl-device.yaml]

properties:
  reg:
    required: true

  interrupts:
    required: true

  clocks:
    required: true

  rmii:
    type: boolean
    description: Use the RMII PHY interface instead of MII.

  phy-address:
    type: int
    description: |
      Fixed MDIO address of the PHY (0-31).  If omitted the driver scans
      the bus for the first PHY responding with a valid ID.

  phy-reset-gpios:
    type: phandle-array
    description: |
      GPIO driving the PHY reset line (active low).  The driver keeps the
      PHY in reset for a few milliseconds and releases it before the first
      MDIO access, so the strap inputs are latched while the RMII reference
      clock is already running.
```

## dts/bindings/ethernet/renesas,ra-ethernet-rmac.yaml
```yaml
# Copyright (c) 2025 Renesas Electronics Corporation
# SPDX-License-Identifier: Apache-2.0

description: Renesas RA Ethernet MAC Controller

compatible: "renesas,ra-ethernet-rmac"

include: [ethernet-controller.yaml, pinctrl-device.yaml]

properties:
  channel:
    type: int
    required: true

  phy-handle:
    required: true

  phy-clock-type:
    type: string
    required: true
    enum:
      - "xtal"
      - "internal"
    description: |
      Specifies the clock type of reference clock:
      "xtal": use xtal as clock source
      "internal": use ETHPHYCLK pin output as clock source

  renesas,no-txc-delay:
    type: boolean
    description: |
      Do not enable the MAC internal TXC delay (MIICRn TXCIDE) in RGMII
      mode. Set this when the PHY already provides the TXC/RXC delays
      (e.g. RTL8211F with delay straps) - stacking both delays shifts
      the sampling window outside the RGMII DDR eye at 1000 Mbps.

  txq-num:
    type: int
    default: 2
    description: Number of TX queues

  rxq-num:
    type: int
    default: 2
    description: Number of RX queues

  txq-len:
    type: int
    default: 4
    description: |
      Number of descriptors in each TX queue

  rxq-len:
    type: int
    default: 4
    description: |
      Number of descriptors in each RX queue

  txb-num:
    type: int
    default: 12
    description: |
      Number of TX buffers

  rxb-num:
    type: int
    default: 12
    description: |
      Number of RX buffers
```

## dts/bindings/flash/gd,gd32-ospi.yaml
```yaml
# Copyright (c) 2026 GD32H7xx Zephyr bring-up
# SPDX-License-Identifier: Apache-2.0

description: |
  GigaDevice GD32H7xx OSPI (OCTOSPI-style Quad/Octal SPI) controller in
  indirect mode driving an external NOR flash.

compatible: "gd,gd32-ospi"

include: [base.yaml, reset-device.yaml, pinctrl-device.yaml]

properties:
  reg:
    required: true

  clocks:
    required: true
    description: |
      Two clocks: the OSPI controller clock and the shared OSPIM
      interconnect clock.

  resets:
    required: true

  pinctrl-0:
    required: true

  pinctrl-names:
    required: true

  size:
    type: int
    required: true
    description: |
      Size of the attached NOR flash in bytes.

  jedec-id:
    type: uint8-array
    required: true
    description: |
      Expected JEDEC manufacturer/device ID of the attached flash,
      read with command 0x9F at driver init and logged for
      verification.
```

## dts/bindings/mtd/gd,gd32-nv-flash-v4.yaml
```yaml
# Copyright (c) 2026 GD32H7xx Zephyr bring-up
# SPDX-License-Identifier: Apache-2.0

description: |
  Flash memory binding of GD32 FMC v4.

  GD32 series use this type flash memory:
    - GD32H7xx

  The main flash array is divided into uniform 4KB sectors, erased by
  address and programmed by word (32-bit).

include: soc-nv-flash.yaml

compatible: "gd,gd32-nv-flash-v4"

properties:
  max-erase-time-ms:
    type: int
    required: true
    description: max erase time(millisecond) of a flash sector
```

## dts/bindings/usb/gd,gd32-usbhs.yaml
```yaml
# Copyright (c) 2026 GD32H7xx Zephyr bring-up
# SPDX-License-Identifier: Apache-2.0

description: |
  GigaDevice GD32H7xx USBHS device controller (DesignWare DWC2 OTG core).

  The GD32 fabric does not implement the read-only GHWCFG1/2/4 identity
  registers (they read back as 0), so the device endpoint capabilities are
  given statically here.  The GD32H7xx USBHS provides 6 IN and 4 OUT device
  endpoints (including control endpoint 0) in dedicated-FIFO mode (per the
  SVD: DIEP0..5 TFLEN registers).

compatible: "gd,gd32-usbhs"

include: snps,dwc2.yaml
```

## soc/gd/gd32/gd32h7xx/Kconfig
```kconfig
# Copyright (c) 2026 GD32H7xx Zephyr bring-up
# SPDX-License-Identifier: Apache-2.0

config SOC_SERIES_GD32H7XX
	select ARM
	select CPU_CORTEX_M7
	select CPU_CORTEX_M_HAS_DWT
	select CPU_HAS_FPU
	select CPU_HAS_FPU_DOUBLE_PRECISION
	select CPU_HAS_ICACHE
	select CPU_HAS_DCACHE
	select CPU_HAS_ARM_MPU
	select GD32_HAS_AF_PINMUX
	select GD32_HAS_IRC_32K
	select SOC_EARLY_INIT_HOOK
	help
	  Enable support for GigaDevice GD32H7xx MCU series
```

## soc/gd/gd32/gd32h7xx/Kconfig.defconfig.series
```kconfig
# Copyright (c) 2026 GD32H7xx Zephyr bring-up
# SPDX-License-Identifier: Apache-2.0

if SOC_SERIES_GD32H7XX

rsource "Kconfig.defconfig.gd32*"

endif # SOC_SERIES_GD32H7XX
```
